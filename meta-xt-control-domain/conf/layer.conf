## meta-xt-control-domain/conf/layer.conf
```bitbake
# We have a conf and classes directory, add to BBPATH
BBPATH .= ":${LAYERDIR}"

# We have a packages directory, add to BBFILES
BBFILES += "${LAYERDIR}/recipes-*/*/*.bb \
            ${LAYERDIR}/recipes-*/*/*.bbappend"

BBFILE_COLLECTIONS += "xt-control-domain"
BBFILE_PATTERN_xt-control-domain := "^${LAYERDIR}/"
BBFILE_PRIORITY_xt-control-domain = "6"

LAYERSERIES_COMPAT_xt-control-domain = "kirkstone"
```

## meta-xt-dom0/conf/layer.conf
```bitbake
# We have a conf and classes directory, add to BBPATH
BBPATH .= ":${LAYERDIR}"

# We have a packages directory, add to BBFILES
BBFILES += "${LAYERDIR}/recipes-*/*/*.bb \
            ${LAYERDIR}/recipes-*/*/*.bbappend"

BBFILE_COLLECTIONS += "xt-dom0"
BBFILE_PATTERN_xt-dom0 := "^${LAYERDIR}/"
BBFILE_PRIORITY_xt-dom0 = "6"

LAYERSERIES_COMPAT_xt-dom0 = "kirkstone"
```

## meta-xt-domu-virtio/conf/layer.conf
```bitbake
# We have a conf and classes directory, add to BBPATH
BBPATH .= ":${LAYERDIR}"

# We have a packages directory, add to BBFILES
BBFILES += "${LAYERDIR}/recipes-*/*/*.bb \
            ${LAYERDIR}/recipes-*/*/*.bbappend"

BBFILE_COLLECTIONS += "xt-domu-virtio"
BBFILE_PATTERN_xt-domu-virtio := "^${LAYERDIR}/"
BBFILE_PRIORITY_xt-domu-virtio = "8"

LAYERSERIES_COMPAT_xt-domu-virtio = "scarthgap"
```

## meta-xt-domx/conf/layer.conf
```bitbake
# We have a conf and classes directory, add to BBPATH
BBPATH .= ":${LAYERDIR}"

# We have a packages directory, add to BBFILES
BBFILES += "${LAYERDIR}/recipes-*/*/*.bb \
            ${LAYERDIR}/recipes-*/*/*.bbappend"

BBFILE_COLLECTIONS += "xt-domx"
BBFILE_PATTERN_xt-domx := "^${LAYERDIR}/"
BBFILE_PRIORITY_xt-domx = "6"

LAYERSERIES_COMPAT_xt-domx = "kirkstone"
```

## meta-xt-domx/conf/machine/generic-armv8-xt.conf
```bitbake
#@TYPE: Machine
#@NAME: generic armv8 machine
#@DESCRIPTION: Machine configuration for running a generic armv8

require conf/machine/include/arm/arch-arm64.inc

KERNEL_IMAGETYPE = "Image"
IMAGE_FSTYPES = "tar.bz2"

MACHINE_FEATURES_BACKFILL_CONSIDERED = "rtc"

PREFERRED_PROVIDER_virtual/kernel = "linux-generic-armv8"
LINUXLIBCVERSION = "6.8%"
```

## meta-xt-driver-domain-virtio/conf/layer.conf
```bitbake
# We have a conf and classes directory, add to BBPATH
BBPATH .= ":${LAYERDIR}"

# We have a packages directory, add to BBFILES
BBFILES += "${LAYERDIR}/recipes-*/*/*.bb \
            ${LAYERDIR}/recipes-*/*/*.bbappend"

BBFILE_COLLECTIONS += "xt-driver-domain-virtio"
BBFILE_PATTERN_xt-driver-domain-virtio := "^${LAYERDIR}/"
BBFILE_PRIORITY_xt-driver-domain-virtio = "8"

LAYERSERIES_COMPAT_xt-driver-domain-virtio = "kirkstone scarthgap"
```

## meta-xt-qemu/conf/layer.conf
```bitbake
# We have a conf and classes directory, add to BBPATH
BBPATH .= ":${LAYERDIR}"

# We have a packages directory, add to BBFILES
BBFILES += "${LAYERDIR}/recipes-*/*/*.bb \
            ${LAYERDIR}/recipes-*/*/*.bbappend"

BBFILE_COLLECTIONS += "xt-qemu"
BBFILE_PATTERN_xt-qemu := "^${LAYERDIR}/"
BBFILE_PRIORITY_xt-qemu = "10"

LAYERSERIES_COMPAT_xt-qemu = "kirkstone"
```
